## firmware/main/Kconfig.azure
```kconfig
# Azure IoT Hub Configuration for ILSS Lanyard
# Copyright (c) 2024
# SPDX-License-Identifier: Apache-2.0

menu "Azure IoT Hub Configuration"

    config ILSS_AZURE_IOT_ENABLED
        bool "Enable Azure IoT Hub Support"
        default y
        help
            Enable or disable the Azure IoT Hub integration.
            This requires MQTT with TLS to be enabled.
    
    if ILSS_AZURE_IOT_ENABLED
    
    config ILSS_AZURE_IOT_HUB_HOSTNAME
        string "Azure IoT Hub Hostname"
        default "ILSS-TEST-IOT-HUB.azure-devices.net"
        help
            The hostname of your Azure IoT Hub (e.g., "myiothub.azure-devices.net").
            You can find this in the Azure Portal under your IoT Hub's Overview page.
    
    config ILSS_AZURE_IOT_DEVICE_ID
        string "Azure IoT Device ID"
        default "device01"
        help
            The device ID registered in your Azure IoT Hub.
            For X.509 authentication, this must match the Common Name (CN) 
            in your device certificate.
    
    config ILSS_AZURE_IOT_SERVER_PORT
        int "Azure IoT Hub MQTT Port"
        default 8883
        help
            The MQTT port for Azure IoT Hub. 
            Typically 8883 for TLS connections.
    
    config ILSS_AZURE_IOT_USE_X509
        bool "Use X.509 Certificate Authentication"
        default y
        help
            Enable X.509 certificate-based authentication for Azure IoT Hub.
            When enabled, the device will use client certificates for authentication.
            When disabled, SAS token authentication will be used.
    
    config ILSS_AZURE_IOT_SAS_TOKEN
        string "Azure IoT Hub SAS Token"
        depends on !ILSS_AZURE_IOT_USE_X509
        default ""
        help
            The Shared Access Signature (SAS) token for authenticating with Azure IoT Hub.
            You can generate this using Azure CLI or the Azure Portal.
            Format: SharedAccessSignature sr=...&sig=...&se=...
    
    config ILSS_AZURE_IOT_KEEPALIVE
        int "MQTT Keepalive Interval (seconds)"
        default 60
        range 30 1200
        help
            MQTT Keepalive interval in seconds. The client will send a PINGREQ
            if no other messages have been sent within this period.
            Azure IoT Hub requires keepalive between 30-1200 seconds.
    
    config ILSS_AZURE_IOT_LOG_LEVEL
        int "Azure IoT Hub log level"
        default 3
        range 0 4
        help
            Log level for Azure IoT Hub feature.
            0 = OFF, 1 = ERROR, 2 = WARNING, 3 = INFO, 4 = DEBUG
    
    endif # ILSS_AZURE_IOT_ENABLED
    
endmenu
```

## firmware/main/Kconfig.debug
```kconfig
menu "ILSS Lanyard - Debug"

config ILSS_DEBUG_BOOT_INTO_FEATURE_DEVELOPMENT_MODE
	string "Boot into feature development mode (unused in twin build)"
	default "n"
	help
	  Retained for sdkconfig compatibility. Digital twin always boots the twin app.

endmenu
```

## firmware/main/Kconfig.logging
```kconfig
# Custom logging configuration for ILSS Lanyard project
menu "ILSS Lanyard - Logging"

config ILSS_LOG_LEVEL
    int "Overall log level"
    default 3
    range 0 4
    help
      Overall log level for the ILSS Lanyard application
      0 = OFF, 1 = ERROR, 2 = WARNING, 3 = INFO, 4 = DEBUG

config ILSS_LOWLEVEL_LOG_LEVEL
    int "Lowlevel log level"
    default 3
    range 0 4
    help
      Overall log level for the ILSS Lanyard application low level
      0 = OFF, 1 = ERROR, 2 = WARNING, 3 = INFO, 4 = DEBUG

config ILSS_NETWORK_LOG_LEVEL
    int "Network client log level"
    default 3
    range 0 4
    help
      Log level for Network client
      0 = OFF, 1 = ERROR, 2 = WARNING, 3 = INFO, 4 = DEBUG
      Set to 4 for detailed network operation logging, 3 for normal operation
      
config ILSS_WIFI_LOG_LEVEL
    int "WiFi driver log level"
    default 3
    range 0 4
    help
      Log level for WiFi driver
      0 = OFF, 1 = ERROR, 2 = WARNING, 3 = INFO, 4 = DEBUG
      Set to 4 for detailed WiFi operation logging, 3 for normal operation

config ILSS_I2C_LOG_LEVEL
    int "I2C driver log level"
    default 2
    range 0 4
    help
      Log level for I2C driver (low-level I2C transactions)
      0 = OFF, 1 = ERROR, 2 = WARNING, 3 = INFO, 4 = DEBUG
      Set to 4 for detailed I2C transaction logging, 2-3 for errors/warnings only

config ILSS_HAPTICS_LOG_LEVEL
    int "Haptics driver log level"
    default 3
    range 0 4
    help
      Log level for DRV2605 haptics driver
      0 = OFF, 1 = ERROR, 2 = WARNING, 3 = INFO, 4 = DEBUG
      Set to 4 for detailed haptics operation logging, 3 for normal operation

config ILSS_TIMER_LOG_LEVEL
    int "Timer driver log level"
    default 3
    range 0 4
    help
      Log level for Timer driver
      0 = OFF, 1 = ERROR, 2 = WARNING, 3 = INFO, 4 = DEBUG
      Set to 4 for detailed timer operation logging, 3 for normal operation

config ILSS_BLUETOOTH_LOG_LEVEL
    int "Bluetooth driver log level"
    default 3
    range 0 4
    help
      Log level for Bluetooth driver
      0 = OFF, 1 = ERROR, 2 = WARNING, 3 = INFO, 4 = DEBUG
      Set to 4 for detailed bluetooth operation logging, 3 for normal operation
    

config ILSS_BUZZER_LOG_LEVEL
    int "Buzzer driver log level"
    default 3
    range 0 4
    help
      Log level for Buzzer driver
      0 = OFF, 1 = ERROR, 2 = WARNING, 3 = INFO, 4 = DEBUG
      Set to 4 for detailed buzzer operation logging, 3 for normal operation

config ILSS_SIDE_BUTTONS_LOG_LEVEL
    int "Side buttons log level"
    default 3
    range 0 4
    help
      Log level for Side buttons
      0 = OFF, 1 = ERROR, 2 = WARNING, 3 = INFO, 4 = DEBUG
      Set to 4 for detailed side buttons operation logging, 3 for normal operation

config ILSS_RGB_LED_LOG_LEVEL
    int "RGB LED log level"
    default 3
    range 0 4
    help
      Log level for RGB LED
      0 = OFF, 1 = ERROR, 2 = WARNING, 3 = INFO, 4 = DEBUG
      Set to 4 for detailed RGB LED operation logging, 3 for normal operation
endmenu
```

## firmware/main/Kconfig.preferences
```kconfig
menu "ILSS Lanyard - Preferences"

config ILSS_PREFERENCES_EXPERIMENTAL_FEATURES_ENABLED
	bool "Enable experimental features"
	default n
	help
	  Enable access to experimental features that are still in development.
	  When enabled, additional configuration options for experimental features
	  will become available. Use with caution as these features may be unstable.

config ILSS_PREFERENCES_PERSONAL_ALERT_BUTTONS_ENABLED
	bool "Enable Personal Alert buttons"
	default y
	help
	  Enable or disable the Personal Alert buttons functionality.
	  When enabled, the device will respond to Personal Alert button presses.

config ILSS_PREFERENCES_LED_INDICATORS_ENABLED
	bool "Enable LED indicators"
	default y
	help
	  Enable or disable the LED indicators on the device.
	  When enabled, LEDs will provide visual feedback for various states and events.

config ILSS_PREFERENCES_AUDIBLE_INDICATORS_ENABLED
	bool "Enable audible indicators"
	default y
	help
	  Enable or disable the audible indicators (buzzer/speaker).
	  When enabled, the device will provide audio feedback for alerts and events.

config ILSS_PREFERENCES_HAPTICS_ENABLED
	bool "Enable haptic feedback"
	default y
	help
	  Enable or disable haptic feedback (vibration).
	  When enabled, the device will provide tactile feedback for alerts and events.

config ILSS_PREFERENCES_HONEYWELL_BEACON_SCANNING_ENABLED
	bool "Enable Honeywell beacon scanning"
	default y
	help
	  Enable or disable scanning for Honeywell-specific beacons.
	  When enabled, the device will actively scan for and process Honeywell beacon signals.

config ILSS_PREFERENCES_THIRD_PARTY_BEACON_SCANNING_ENABLED
	bool "Enable third party beacon scanning"
	default n
	depends on ILSS_PREFERENCES_EXPERIMENTAL_FEATURES_ENABLED
	help
	  Enable or disable scanning for third-party beacons.
	  This is an experimental feature. When enabled, the device will scan for
	  non-Honeywell beacon signals.
	  This option is only available when experimental features are enabled.

config ILSS_PREFERENCES_INACTIVITY_ALERT_ENABLED
	bool "Enable inactivity alert"
	default n
	depends on ILSS_PREFERENCES_EXPERIMENTAL_FEATURES_ENABLED
	help
	  Enable or disable inactivity alert functionality.
	  This is an experimental feature. When enabled, the device will alert
	  users after a period of inactivity.
	  This option is only available when experimental features are enabled.

config ILSS_PREFERENCES_INCOMING_FIRE_ALARM_EVENTS_ENABLED
	bool "Enable incoming fire alarm events alert"
	default y
	help
	  Enable or disable alerts for incoming fire alarm events.
	  When enabled, the device will provide alerts when fire alarm events are received.

config ILSS_PREFERENCES_WIFI_ENABLED
	bool "Enable Wi-Fi functionality"
	default y
	help
	  Enable or disable Wi-Fi connectivity.
	  When enabled, the device will be able to connect to Wi-Fi networks for
	  communication and updates.

config ILSS_PREFERENCES_NFC_SESSION_SHARING_ENABLED
	bool "Enable NFC session sharing"
	default y
	help
	  Enable or disable NFC session sharing functionality.
	  When enabled, the device can share session information via NFC.

config ILSS_PREFERENCES_QUIESCENT_BEACON_SCAN_MODE_SCAN_INTERVAL_MS
	int "Quiescent mode beacon scanning interval (milliseconds)"
	default 60000
	range 1000 300000
	help
	  The interval between beacon scans when in quiescent mode.
	  Default is 60 seconds (60000ms). Range is 1-300 seconds.

config ILSS_PREFERENCES_FAST_BEACON_SCAN_MODE_SCAN_INTERVAL_MS
	int "Fast scan mode beacon scanning interval (milliseconds)"
	default 20000
	range 1000 60000
	help
	  The interval between beacon scans when in fast scan mode.
	  Default is 20 seconds (20000ms). Range is 1-60 seconds.

config ILSS_PREFERENCES_PERSONAL_ALERT_BUTTON_TRIGGER_DELAY_MS
	int "Personal Alert Button Trigger Delay (milliseconds)"
	default 5000
	range 1000 10000
	help
	  The delay before triggering a Personal Alert after button press.
	  Default is 5 seconds (5000ms). Range is 1-10 seconds.
	  This delay allows for accidental button presses to be cancelled.

config ILSS_PREFERENCES_BEACON_SCAN_WINDOW_MS
	int "Beacon scan window duration (milliseconds)"
	default 3000
	range 1000 10000
	help
	  The duration of each beacon scan window.
	  Default is 3 seconds (3000ms). Range is 1-10 seconds.
	  Shorter scan windows reduce power consumption but may miss some beacons.

config ILSS_PREFERENCES_BEACON_RSSI_CHANGE_THRESHOLD_DB
	int "Beacon RSSI change threshold for logging (dB)"
	default 5
	range 1 20
	help
	  The minimum RSSI change (in dB) required to log beacon updates.
	  Default is 5dB. Range is 1-20dB.
	  Higher values reduce logging noise from minor signal fluctuations.

endmenu
```

## firmware/main/Kconfig.projbuild
```kconfig
mainmenu "ILSS Lanyard application"

menu "ILSS Lanyard - Configuration"
rsource "Kconfig.debug"
rsource "Kconfig.logging"
rsource "Kconfig.preferences"
rsource "Kconfig.twin"

endmenu
```

## firmware/main/Kconfig.twin
```kconfig
menu "ILSS Digital Twin"

config ILSS_TWIN_ADV_NAME_PREFIX
	string "BLE advertising name prefix"
	default "ILSS-LY"
	help
	  Prefix for the BLE GAP device name. Serial suffix is appended from ble_prov.

config ILSS_TWIN_ENCRYPT_ENABLE
	bool "Enable encrypted twin Data payloads after pairing"
	default y
	help
	  When paired with a factory secret, encrypt packed-protocol Data with AES-256-GCM.

config ILSS_TWIN_HEARTBEAT_LOG_MS
	int "Application heartbeat log interval (ms)"
	default 30000
	range 5000 300000

endmenu
```

## firmware/sdkconfig.defaults
```kconfig
# Larger NimBLE host stack — GAP handlers + ATT notify need headroom on ESP32-S3.
CONFIG_BT_NIMBLE_HOST_TASK_STACK_SIZE=8192

# Keep FreeRTOS software timers (buzzer Code-3 steps) off NimBLE's core.
CONFIG_FREERTOS_TIMER_TASK_AFFINITY_CPU1=y

# Advertise preferred connection parameters (units: interval=1.25ms, supervision=10ms).
# Hint centrals toward a longer supervision timeout under alert EMI.
CONFIG_BT_NIMBLE_SVC_GAP_PPCP_MIN_CONN_INTERVAL=24
CONFIG_BT_NIMBLE_SVC_GAP_PPCP_MAX_CONN_INTERVAL=80
CONFIG_BT_NIMBLE_SVC_GAP_PPCP_SLAVE_LATENCY=0
CONFIG_BT_NIMBLE_SVC_GAP_PPCP_SUPERVISION_TMO=2000
```
